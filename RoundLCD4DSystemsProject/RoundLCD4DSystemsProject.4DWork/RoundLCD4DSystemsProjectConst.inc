// File generated 7/29/2023 4:35:04 PM
// Warning! This is a generated file, any manual changes will be
// lost during the next generation.

#constant  IFONT_OFFSET     0

#constant  ffsEndUnits4k    0x0004  // First unused 4k Sector on Flash
#constant  ffsEnd4kH        0x0000  // Address of first unused 4k Sector on Flash, High
#constant  ffsEnd4kL        0x4000  // Address of first unused 4k Sector on Flash, Low
#constant  ffsEndUnits32k   0x0001  // First unused 32k Block on Flash
#constant  ffsEnd32kH       0x0000  // Address of first unused 32k Block on Flash, High
#constant  ffsEnd32kL       0x8000  // Address of first unused 32k Block on Flash, Low
#constant  ffsEndUnits64k   0x0001  // First unused 64k Block on Flash
#constant  ffsEnd64kH       0x0001  // Address of first unused 64k Block on Flash, High
#constant  ffsEnd64kL       0x0000  // Address of first unused 64k Block on Flash, Low

#IFNOT EXISTS NOGLOBALS
var hndl ;
#ENDIF
